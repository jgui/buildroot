/* Include the default DT from the kernel */
#include "socfpga_cyclone5_de10_nano.dts"
#include "socfpga-mw-fpga-bridge.dtsi"
#include "socfpga-mw-mwipcore.dtsi"
/ {
	chosen {
		bootargs = "console=ttyS0,115200 root=/dev/mmcblk0p3 rw rootwait earlyprintk";
	};
};
